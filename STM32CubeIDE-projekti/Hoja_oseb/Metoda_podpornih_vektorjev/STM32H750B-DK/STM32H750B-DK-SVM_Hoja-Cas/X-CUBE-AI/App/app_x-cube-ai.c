
/**
  ******************************************************************************
  * @file    app_x-cube-ai.c
  * @author  X-CUBE-AI C code generator
  * @brief   AI program body
  ******************************************************************************
  * @attention
  *
  * Copyright (c) 2023 STMicroelectronics.
  * All rights reserved.
  *
  * This software is licensed under terms that can be found in the LICENSE file
  * in the root directory of this software component.
  * If no LICENSE file comes with this software, it is provided AS-IS.
  *
  ******************************************************************************
  */

 /*
  * Description
  *   v1.0 - Minimum template to show how to use the Embedded Client API
  *          model. Only one input and one output is supported. All
  *          memory resources are allocated statically (AI_NETWORK_XX, defines
  *          are used).
  *          Re-target of the printf function is out-of-scope.
  *   v2.0 - add multiple IO and/or multiple heap support
  *
  *   For more information, see the embeded documentation:
  *
  *       [1] %X_CUBE_AI_DIR%/Documentation/index.html
  *
  *   X_CUBE_AI_DIR indicates the location where the X-CUBE-AI pack is installed
  *   typical : C:\Users\<user_name>\STM32Cube\Repository\STMicroelectronics\X-CUBE-AI\7.1.0
  */

#ifdef __cplusplus
 extern "C" {
#endif

/* Includes ------------------------------------------------------------------*/

#if defined ( __ICCARM__ )
#elif defined ( __CC_ARM ) || ( __GNUC__ )
#endif

/* System headers */
#include <stdint.h>
#include <stdlib.h>
#include <stdio.h>
#include <inttypes.h>
#include <string.h>

#include "app_x-cube-ai.h"
#include "main.h"
#include "ai_datatypes_defines.h"
#include "svm.h"
#include "svm_data.h"

/* USER CODE BEGIN includes */

#define BUFSIZE 256
char	SendBuffer[BUFSIZE];

int counterOfTestData = 0;

int numberOfDurations = 100;
uint32_t averageDurationValue = 0;
int countDurations = 0;

float testData[][16] = {{-0.0006153846153846, 0.0009126008090542, 0.005, 0.001100699078558, 0.0215576923076923, 0.0014730066261595, 0.007, 0.0216079579357663, 0.99125, 0.0013850159676946, 0.007, 0.991250967600653, 0.9914860865289108, 0.0013915363564239, 0.0069986197331466, 0.9914870630289868},
		 {-0.0008076923076923, 0.0011525633895208, 0.006, 0.0014073980356563, 0.022125, 0.0014589742181514, 0.007, 0.022173051904716, 0.9918365384615384, 0.0013875169917398, 0.007, 0.9918375089856046, 0.9920853495423456, 0.0013886879458306, 0.0069986197331466, 0.9920863214613784},
		 {-0.0010961538461538, 0.0010698600804385, 0.006, 0.001531715980903, 0.0219134615384615, 0.0014878390171078, 0.007, 0.0219639127101357, 0.9917115384615384, 0.0014456371826655, 0.007, 0.9917125921276866, 0.9919559117196474, 0.0014471366359818, 0.006999781054934, 0.9919569673125946},
		 {-0.0007596153846153, 0.0009756180714305, 0.005, 0.0012364651850521, 0.0213173076923076, 0.0014693301919642, 0.0089999999999999, 0.0213678856806549, 0.9916826923076922, 0.0013746637566281, 0.007, 0.9916836450819771, 0.9919136446624848, 0.001374350784471, 0.0069977714978647, 0.9919145967812412},
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		 {-0.9864326923076924, 0.3191104452049562, 1.58, 1.036764646721862, -0.1247884615384615, 0.2427659791570776, 0.985, 0.2729605846440668, -0.0121249999999999, 0.2979221854877029, 1.481, 0.2981688183408339, 1.0608630101497842, 0.3359504894895181, 1.4273694517100344, 1.1127861688987275}};


int size = sizeof(testData) / sizeof(testData[0]);

uint32_t timestamp;

/* USER CODE END includes */

/* IO buffers ----------------------------------------------------------------*/

#if !defined(AI_SVM_INPUTS_IN_ACTIVATIONS)
AI_ALIGNED(4) ai_i8 data_in_1[AI_SVM_IN_1_SIZE_BYTES];
ai_i8* data_ins[AI_SVM_IN_NUM] = {
data_in_1
};
#else
ai_i8* data_ins[AI_SVM_IN_NUM] = {
NULL
};
#endif

#if !defined(AI_SVM_OUTPUTS_IN_ACTIVATIONS)
AI_ALIGNED(4) ai_i8 data_out_1[AI_SVM_OUT_1_SIZE_BYTES];
AI_ALIGNED(4) ai_i8 data_out_2[AI_SVM_OUT_2_SIZE_BYTES];
ai_i8* data_outs[AI_SVM_OUT_NUM] = {
data_out_1,
data_out_2
};
#else
ai_i8* data_outs[AI_SVM_OUT_NUM] = {
NULL,
NULL
};
#endif

/* Activations buffers -------------------------------------------------------*/

AI_ALIGNED(32)
static uint8_t pool0[AI_SVM_DATA_ACTIVATION_1_SIZE];

ai_handle data_activations0[] = {pool0};

/* AI objects ----------------------------------------------------------------*/

static ai_handle svm = AI_HANDLE_NULL;

static ai_buffer* ai_input;
static ai_buffer* ai_output;

static void ai_log_err(const ai_error err, const char *fct)
{
  /* USER CODE BEGIN log */
  if (fct)
    printf("TEMPLATE - Error (%s) - type=0x%02x code=0x%02x\r\n", fct,
        err.type, err.code);
  else
    printf("TEMPLATE - Error - type=0x%02x code=0x%02x\r\n", err.type, err.code);

  do {} while (1);
  /* USER CODE END log */
}

static int ai_boostrap(ai_handle *act_addr)
{
  ai_error err;

  /* Create and initialize an instance of the model */
  err = ai_svm_create_and_init(&svm, act_addr, NULL);
  if (err.type != AI_ERROR_NONE) {
    ai_log_err(err, "ai_svm_create_and_init");
    return -1;
  }

  ai_input = ai_svm_inputs_get(svm, NULL);
  ai_output = ai_svm_outputs_get(svm, NULL);

#if defined(AI_SVM_INPUTS_IN_ACTIVATIONS)
  /*  In the case where "--allocate-inputs" option is used, memory buffer can be
   *  used from the activations buffer. This is not mandatory.
   */
  for (int idx=0; idx < AI_SVM_IN_NUM; idx++) {
	data_ins[idx] = ai_input[idx].data;
  }
#else
  for (int idx=0; idx < AI_SVM_IN_NUM; idx++) {
	  ai_input[idx].data = data_ins[idx];
  }
#endif

#if defined(AI_SVM_OUTPUTS_IN_ACTIVATIONS)
  /*  In the case where "--allocate-outputs" option is used, memory buffer can be
   *  used from the activations buffer. This is no mandatory.
   */
  for (int idx=0; idx < AI_SVM_OUT_NUM; idx++) {
	data_outs[idx] = ai_output[idx].data;
  }
#else
  for (int idx=0; idx < AI_SVM_OUT_NUM; idx++) {
	ai_output[idx].data = data_outs[idx];
  }
#endif

  return 0;
}

static int ai_run(void)
{
  ai_i32 batch;

  batch = ai_svm_run(svm, ai_input, ai_output);
  if (batch != 1) {
    ai_log_err(ai_svm_get_error(svm),
        "ai_svm_run");
    return -1;
  }

  return 0;
}

/* USER CODE BEGIN 2 */
int acquire_and_process_data(ai_float* data[])
{
	if(counterOfTestData == 0) {
		timestamp = htim16.Instance->CNT;
	}

	//SVM hoja -> using offsets and factors from Orange data preprocessing
	data[0][0] = (testData[counterOfTestData][0] - (-0.7925340396583439)) * 2.0949933205020708;
	data[0][1] = (testData[counterOfTestData][1] - 0.25463438722461235) * 5.929210562633304;
	data[0][2] = (testData[counterOfTestData][2] - 1.2237432034064877) * 1.1805004714159546;
	data[0][3] = (testData[counterOfTestData][3] - 0.9080303069938368) * 2.8316304285664726;

	data[0][4] = (testData[counterOfTestData][4] - (-0.043692102975635576)) * 3.7465012332289103;
	data[0][5] = (testData[counterOfTestData][5] - 0.2380924561831248) * 6.581672613424032;
	data[0][6] = (testData[counterOfTestData][6] - 1.2170445463478536) * 1.2546657227425297;
	data[0][7] = (testData[counterOfTestData][7] - 0.3188075751411812) * 4.415641148049384;

	data[0][8] = (testData[counterOfTestData][8] - 0.0036754295900627365) * 3.7391857781655413;
	data[0][9] = (testData[counterOfTestData][9] - 0.23952607306415402) * 7.479754757980447;
	data[0][10] = (testData[counterOfTestData][10] - 1.2980415984277747) * 1.313726772069218;
	data[0][11] = (testData[counterOfTestData][11] - 0.3156636494289826) * 4.60580702527008;

	data[0][12] = (testData[counterOfTestData][12] - 1.0669456527929735) * 15.930676904057798;
	data[0][13] = (testData[counterOfTestData][13] - 0.2766352751305663) * 5.763399986208959;
	data[0][14] = (testData[counterOfTestData][14] - 1.3165988949163936) * 1.1621726084324315;
	data[0][15] = (testData[counterOfTestData][15] - 1.1134635041015108) * 10.457188751844905;

	counterOfTestData++;

  return 0;
}

int post_process(ai_i8* data[])
{
	if(counterOfTestData == size) {

		counterOfTestData = 0;

		countDurations++;

		uint32_t duration = htim16.Instance->CNT;

		if(duration >= timestamp)
			duration -= timestamp;
		else
			duration += (65535 - timestamp) + 1; //+1 because of counting from 0 onwards

		//snprintf(SendBuffer,BUFSIZE,"1 Trajanje izvajanja: %lu milisekund. \r\n", duration);
		//CDC_Transmit_FS(SendBuffer,strlen(SendBuffer));
		averageDurationValue += duration;

		if(countDurations == numberOfDurations) {
			snprintf(SendBuffer,BUFSIZE,"Trajanje izvajanja: [%lu] %lu milisekund. \r\n", averageDurationValue, averageDurationValue / 100);
			CDC_Transmit_FS(SendBuffer,strlen(SendBuffer));

			countDurations = 0;
			averageDurationValue = 0;
		}
	}

  return 0;
}
/* USER CODE END 2 */

/* Entry points --------------------------------------------------------------*/

void MX_X_CUBE_AI_Init(void)
{
    BSP_QSPI_Init_t qspiInit;
    qspiInit.InterfaceMode=MT25TL01G_QPI_MODE;
    qspiInit.TransferRate= MT25TL01G_DTR_TRANSFER ;
    qspiInit.DualFlashMode= MT25TL01G_DUALFLASH_ENABLE;
    BSP_QSPI_Init(0,&qspiInit);
    BSP_QSPI_EnableMemoryMappedMode(0);
    /* USER CODE BEGIN 5 */

    HAL_TIM_Base_Start(&htim16);

  printf("\r\nTEMPLATE - initialization\r\n");

  ai_boostrap(data_activations0);
    /* USER CODE END 5 */
}

void MX_X_CUBE_AI_Process(void)
{
    /* USER CODE BEGIN 6 */
  int res = -1;

  printf("TEMPLATE - run - main loop\r\n");

  if (svm) {

    do {
      /* 1 - acquire and pre-process input data */
      res = acquire_and_process_data(data_ins);
      /* 2 - process the data - call inference engine */
      if (res == 0)
        res = ai_run();
      /* 3- post-process the predictions */
      if (res == 0)
        res = post_process(data_outs);
    } while (res==0);
  }

  if (res) {
    ai_error err = {AI_ERROR_INVALID_STATE, AI_ERROR_CODE_NETWORK};
    ai_log_err(err, "Process has FAILED");
  }
    /* USER CODE END 6 */
}
#ifdef __cplusplus
}
#endif
